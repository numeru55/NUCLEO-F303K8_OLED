/*
 * SSD1306_I2C.c
 *
 *  Created on: 2021/09/25
 */

#include "main.h"
#include "SSD1306_I2C.h"

// my sample for OLED SSD1306 unit 128*64 or 128*32

I2C_HandleTypeDef hi2c1;

#define OLED_HEIGHT 32
// #define OLED_HEIGHT 64

#define OLED_SETCONTRAST 0x81
#define OLED_DISPLAYALLON_RESUME 0xA4
#define OLED_DISPLAYALLON 0xA5
#define OLED_NORMALDISPLAY 0xA6
#define OLED_INVERTDISPLAY 0xA7
#define OLED_DISPLAYOFF 0xAE
#define OLED_DISPLAYON 0xAF
#define OLED_SETDISPLAYOFFSET 0xD3
#define OLED_SETCOMPINS 0xDA
#define OLED_SETVCOMDETECT 0xDB
#define OLED_SETDISPLAYCLOCKDIV 0xD5
#define OLED_SETPRECHARGE 0xD9
#define OLED_SETMULTIPLEX 0xA8
#define OLED_SETLOWCOLUMN 0x00
#define OLED_SETHIGHCOLUMN 0x10
#define OLED_SETSTARTLINE 0x40
#define OLED_MEMORYMODE 0x20
#define OLED_COLUMNADDR 0x21
#define OLED_PAGEADDR 0x22
#define OLED_COMSCANINC 0xC0
#define OLED_COMSCANDEC 0xC8
#define OLED_SEGREMAP 0xA0
#define OLED_CHARGEPUMP 0x8D

///////////////////////////////////////////////////////////////////////////////

static const char OLED_characters[] = {
		0x00, 0x00, 0x00, 0x00, 0x00, //    (Space)
		0x00, 0x00, 0x5F, 0x00, 0x00, //    !
		0x00, 0x07, 0x00, 0x07, 0x00, //    "
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		0x02, 0x01, 0x02, 0x04, 0x02, //    ~
		};

uint16_t _address = 0x78;
// char _address = 0x3c; // for Arduino

uint8_t I2C_DATA[2]; // max character width 5dot + data

void OLED_command(char command) {
	I2C_DATA[0] = 0;
	I2C_DATA[1] = command;
	HAL_I2C_Master_Transmit(&hi2c1, (uint16_t)_address,  (uint8_t *)I2C_DATA, 2, 300);
}

void OLED_data(char data) {
	I2C_DATA[0] = 0x40;
	I2C_DATA[1] = data;
	HAL_I2C_Master_Transmit(&hi2c1, (uint16_t)_address, (uint8_t *) I2C_DATA, 2, 300);
}

void OLED_Init() {
	OLED_command(OLED_DISPLAYOFF);         // 0xAE
	OLED_command(OLED_SETDISPLAYCLOCKDIV); // 0xD5
	OLED_command(0x80);                    // the suggested ratio 0x80
	OLED_command(OLED_SETMULTIPLEX);       // 0xA8

#if OLED_HEIGHT == 32
	OLED_command(0x1F);
#elif OLED_HEIGHT == 64
	OLED_command(0x7F);
	#endif

	OLED_command(OLED_SETDISPLAYOFFSET);   // 0xD3
	OLED_command(0x0);                     // no offset
	OLED_command(OLED_SETSTARTLINE | 0x0); // line #0
	OLED_command(OLED_CHARGEPUMP);         // 0x8D
	OLED_command(0xAF);
	OLED_command(OLED_MEMORYMODE); // 0x20
	OLED_command(0x00);            // 0x0 act like ks0108
	OLED_command(OLED_SEGREMAP | 0x1);
	OLED_command(OLED_COMSCANDEC);
	OLED_command(OLED_SETCOMPINS); // 0xDA

#if OLED_HEIGHT == 32
	OLED_command(0x02);
#elif OLED_HEIGHT == 64
OLED_command(0x12);
#endif

	OLED_command(OLED_SETCONTRAST); // 0x81

#if OLED_HEIGHT == 32
	OLED_command(0x8F);
#elif OLED_HEIGHT == 64
	OLED_command(0x9F);
#endif

	OLED_command(OLED_SETPRECHARGE); // 0xd9
	OLED_command(0xF1);
	OLED_command(OLED_SETVCOMDETECT); // 0xDB
	OLED_command(0x40);
	OLED_command(OLED_DISPLAYALLON_RESUME); // 0xA4
	OLED_command(OLED_NORMALDISPLAY);       // 0xA6
	OLED_command(OLED_DISPLAYON);           //--turn on oled panel
}

void OLED_write_bit(char ch, int x, int y) {
	OLED_command(0x20);            //
	OLED_command(0x02);            // Page addressing mode
	OLED_command(y + 0xB0);        // Set page start addres
	OLED_command(x & 0x0F);        // Set lower column start address
	OLED_command(0x10 + (x >> 4)); // Set higher column start address

	OLED_data(ch);
}

void OLED_clear() {
	uint8_t x = 0;
	uint8_t y = 0;
	for (x = 0; x < 128; x++) {
		for (y = 0; y < OLED_HEIGHT / 8; y++) {
			OLED_write_bit(0, x, y);
		}
	}
}

// x: 0 to 127
// y: 0 to 3 or 7

void OLED_char6(char ch, int x, int y) {

	int table_offset = (ch - ' ') * 5;

	for (int i = 0; i < 5; i++) {
		OLED_write_bit(OLED_characters[i + table_offset], x + i, y);
	}

}

void OLED_string6(char *str, int x, int y) {

	int pos = 0;
	int startx = x;
	int starty = y;
	while (str[pos] != '\0') {
		OLED_char6(str[pos], startx, starty);
		if (startx >= 123) {
			starty++;
			startx = 0;
		} //wrap around
		startx += 6;
		pos += 1;
	}
}
